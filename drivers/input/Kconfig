## dts/bindings/input/zmk,hid-touchpad.yml
```yaml
#
# Copyright (c) 2022 The ZMK Contributors
# Copyright (c) 2025-2026 Framework Computer Inc
#
# SPDX-License-Identifier: MIT
#

description: >
  I2C HID Touchpad passthrough driver. Forwards raw HID reports from an
  I2C HID touchpad to USB and BLE host interfaces.

compatible: "zmk,hid-touchpad"

include: [i2c-device.yaml]

properties:
  dr-gpios:
    type: phandle-array
    description: Interrupt (data ready) pin for the touchpad

  hid-descriptor-register:
    type: int
    required: true
    description: I2C register address for the HID descriptor (e.g. 0x20)

  fallback-command-register:
    type: int
    description: >
      Command register to use when the pad presents no usable HID
      descriptor at init, from the part's datasheet (e.g. PixArt PCT1036:
      0x22). With it, and fallback-data-register, the driver comes up
      anyway, with feature reports working and input off until a
      descriptor read succeeds, so a pad left in ROM mode by an
      interrupted firmware update can still be reflashed. Without them,
      init fails as before. Both or neither.

  fallback-data-register:
    type: int
    description: >
      Data register to go with fallback-command-register (PixArt PCT1036:
      0x23).

  report-descriptor:
    type: uint8-array
    required: true
    description: Full HID report descriptor blob

  ble-report-descriptor:
    type: uint8-array
    description: >
      Report map to serve over BLE instead of report-descriptor. A GATT
      attribute value is limited to 512 bytes, and a host may stop reading
      the Report Map there, so a longer descriptor needs a BLE copy: the
      same reports, described identically, with collections BLE doesn't
      need left out. scripts/ble_report_map.py writes and checks it.

  mouse-input-report-id:
    type: int
    required: true
    description: Report ID for mouse input reports (e.g. 1)

  ptp-input-report-id:
    type: int
    required: true
    description: Report ID for PTP (precision touchpad) input reports (e.g. 4)

  mouse-input-report-size:
    type: int
    required: true
    description: Size in bytes of mouse input report data (excluding report ID)

  ptp-input-report-size:
    type: int
    required: true
    description: Size in bytes of PTP input report data (excluding report ID)

  feature-report-ids:
    type: array
    required: true
    description: List of feature report IDs exposed by this touchpad

  feature-report-sizes:
    type: array
    required: true
    description: >
      Data size in bytes (excluding the report ID) of each feature report,
      parallel to feature-report-ids. Bounds the I2C read a GET_REPORT
      clocks, so a 1-byte report doesn't cost a full-buffer transfer.

  static-feature-report-ids:
    type: array
    description: >
      Feature reports that describe the pad rather than set it, such as PTP
      Contact Count Maximum, Pad Type and the certification blob. Host GETs
      for them are answered from static-feature-reports and never reach the
      pad: a host reads them while it enumerates, when the pad may be busy
      (or missing, on a bench board), and Windows holds every touchpad's
      input until they answer. Host SETs still go to the pad. Each must also
      be in feature-report-ids. Needs static-feature-reports.

  static-feature-reports:
    type: uint8-array
    description: >
      The data of each static-feature-report-ids entry (excluding the report
      ID), one after the other in the same order, each as long as its
      feature-report-sizes entry.

  host-state-report-ids:
    type: array
    description: >
      One-byte feature reports that hold a host's mode for the pad, such as
      PTP Input Mode, Surface/Button Switch and Latency Mode. Each host
      (USB, every BLE profile) gets its own copy: its SETs and GETs go to
      that copy, and only the selected host's copy is written to the pad,
      again on every endpoint or profile switch. Each must also be in
      feature-report-ids with size 1. Needs host-state-report-defaults.

  host-state-report-defaults:
    type: uint8-array
    description: >
      The pad's power-on value of each host-state-report-ids entry, in the
      same order. A host that never wrote a report gets this value, so a
      host without a PTP driver (macOS) keeps the pad in mouse mode.

  host-state-saved-report-ids:
    type: array
    description: >
      The host-state-report-ids whose BLE copies are saved to settings and
      survive a keyboard reset, for a host that doesn't write them again
      when it reconnects. Saved once per change, so list only reports a
      host sets once (Input Mode), not ones it toggles around every suspend
      (Surface/Button Switch, Latency Mode). The others go back to the
      defaults on a keyboard reset. Default: none.

  ble-feature-report-ids:
    type: array
    description: >
      Feature reports to expose over BLE (default: feature-report-ids). Each
      must also be in feature-report-ids. Set it when ble-report-descriptor
      leaves some out.

  # PixArt pads only, written over vendor feature report 0x43. Each value
  # overrides the user register the firmware's parameter section loads at
  # pad boot; leave a property out to keep the firmware's value. The
  # register addresses are the PCT1036 (PJP360) layout: other PixArt parts
  # differ (the PJP343 keeps its rest timeouts in seconds at 0x18/0x19).

  pixart,max-report-rate:
    type: int
    description: >
      Run-mode report rate to request, in Hz, 1-255 (user bank 0
      MAX_REPORT_RATE, 0x12). Daisy firmware 0x1204 ships 140, earlier
      releases 130. The pad may deliver less under noise avoidance
      (OBS_REPORT_RATE, 0x10/0x11).

  pixart,rest1-frame-rate:
    type: int
    description: >
      Frame rate in Hz, 2-255 (1 Hz hangs Daisy firmware 0x1204), of the
      first idle mode, entered after
      REST1_DS (0x18/0x19, 50 ms units) without touch (user bank 0
      REST1_FRAME_RATE, 0x1c). Daisy firmware ships 20. Derived from the
      slow oscillator, so the real rate may be off by up to 50%.

  pixart,rest2-frame-rate:
    type: int
    description: >
      Frame rate in Hz, 2-255 (1 Hz hangs Daisy firmware 0x1204), of the
      second, deeper idle mode, entered after a further REST2_DS
      (0x1a/0x1b) (user bank 0 REST2_FRAME_RATE, 0x1d). Bounds how long the
      first touch after a long idle takes to register. Daisy firmware
      0x1203+ ships 20, 0x1202 shipped 4. SET_POWER on reloads it from the
      firmware's parameter section, so pixart_tp_set_power() writes it again
      after every on.

  pixart,rest1-timeout-ms:
    type: int
    description: >
      Time without touch before the pad drops from run to the first idle
      mode, in ms: a multiple of 50, 50-3276750 (user bank 0 REST1_DS,
      0x18/0x19, 50 ms units). Counted from the last touch or SET_POWER on;
      host register reads don't count as activity. Daisy firmware ships
      10000.

  pixart,rest2-timeout-ms:
    type: int
    description: >
      Further time in the first idle mode before the second, in ms: a
      multiple of 50, 50-3276750 (user bank 0 REST2_DS, 0x1a/0x1b). Daisy
      firmware ships 10000.

  pixart,sleep-report-rate:
    type: int
    description: >
      Scan rate in Hz, 2-255 (1 Hz hangs Daisy firmware 0x1204), while the
      pad is in HID sleep (modern standby,
      SET_POWER sleep without HID suspend), which bounds how long a touch
      takes to wake it (user bank 0 HID_SLEEP_REPORT_RATE, 0x8e; datasheet
      SLEEP_REPORT_RATE). The pad latches it when sleep starts, so a write
      applies from the next SET_POWER sleep. Unused in HID suspend, which
      doesn't scan. Daisy firmware ships 4.

  pixart,sleep-report-latency:
    type: int
    description: >
      Raw value, 0-255, of user bank 0 HID_SLEEP_REPORT_LATENCY (0x8d), an
      HID sleep parameter. PixArt's register table names it but documents
      neither unit nor effect; the datasheet leaves it out. Daisy firmware
      ships 23. Set it only to pin the firmware's value.

  pixart,sleep-drive-cycle:
    type: int
    description: >
      Raw value, 0-255, of user bank 0 HID_SLEEP_DRIVE_CYCLE (0x8f), an HID
      sleep parameter. PixArt's register table names it but documents
      neither unit nor effect; the datasheet leaves it out. Daisy firmware
      ships 15. Set it only to pin the firmware's value.

  pixart,hid-suspend-enable:
    type: array
    description: >
      <bank reg mask> of the user register bit that turns SET_POWER sleep
      into HID suspend: no scanning, only a button wakes the pad (PCT1036:
      <0 0x8c 0x08>, HID_SUSPEND; PJP343: <0 0xb6 0x01>). With it,
      pixart_tp_set_power() offers PIXART_TP_POWER_SUSPEND, and the bit is
      cleared at boot and after a firmware update so a plain sleep keeps
      waking on touch.
```

## dts/bindings/input/zmk,i2c-hid.yml
```yaml
#
# Copyright (c) 2022 The ZMK Contributors
#
# SPDX-License-Identifier: MIT
#

description: >
  I2C HID device passthrough driver. Forwards raw HID reports from an
  I2C HID device to USB and BLE host interfaces.

compatible: "zmk,i2c-hid"

include: [i2c-device.yaml]

properties:
  dr-gpios:
    type: phandle-array
    description: Interrupt (data ready) pin for the I2C HID device

  hid-descriptor-register:
    type: int
    required: true
    description: I2C register address for the HID descriptor (e.g. 0x20)

  report-descriptor:
    type: uint8-array
    required: true
    description: Full HID report descriptor blob

  mouse-input-report-id:
    type: int
    required: true
    description: Report ID for mouse input reports (e.g. 1)

  ptp-input-report-id:
    type: int
    required: true
    description: Report ID for PTP (precision touchpad) input reports (e.g. 4)

  mouse-input-report-size:
    type: int
    required: true
    description: Size in bytes of mouse input report data (excluding report ID)

  ptp-input-report-size:
    type: int
    required: true
    description: Size in bytes of PTP input report data (excluding report ID)

  feature-report-ids:
    type: array
    required: true
    description: List of feature report IDs exposed by this device
```
