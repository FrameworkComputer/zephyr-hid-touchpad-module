## drivers/input/Kconfig
```kconfig
# Copyright (c) 2022 The ZMK Contributors
# Copyright (c) 2025-2026 Framework Computer Inc
# SPDX-License-Identifier: MIT

menuconfig ZMK_HID_TOUCHPAD
    bool "I2C HID Touchpad Passthrough"
    default y
    depends on DT_HAS_ZMK_HID_TOUCHPAD_ENABLED && I2C
    help
      Enable I2C HID touchpad passthrough driver.

if ZMK_HID_TOUCHPAD

config INPUT_HID_TOUCHPAD_INIT_PRIORITY
    int "Init priority"
    default 75
    help
      Device driver initialization priority.

config HID_TOUCHPAD_WORKQUEUE_STACK_SIZE
    int "Touchpad work queue stack size"
    default 1280
    help
      Stack size of the dedicated work queue that reads input reports over
      I2C. A dedicated queue keeps the latency-sensitive report reads
      independent of system workqueue stalls (e.g. HID TX submits blocking
      on their semaphore).

config HID_TOUCHPAD_WORKQUEUE_PRIORITY
    int "Touchpad work queue cooperative priority"
    default 3
    help
      Cooperative priority (K_PRIO_COOP) of the touchpad report work queue.

# The passthrough backends are ZMK-specific: they follow the keyboard's
# endpoint selection (zmk_endpoint_get_selected), the BLE one notifies the
# active profile's central and both include ZMK's private app/include
# headers. Without ZMK's USB/BLE subsystems they can't compile, so they only
# offer themselves when those are enabled; the plain driver and its
# hid_touchpad_register_input_cb() API stay usable from any Zephyr app.
config HID_PASSTHROUGH_USB
    bool "USB HID Passthrough for touchpad"
    depends on ZMK_USB
    depends on USB_DEVICE_HID || USBD_HID_SUPPORT
    default y
    help
      Enable USB HID passthrough for the touchpad. Works with either the
      legacy USB device stack (CONFIG_USB_DEVICE_HID) or the new stack
      (CONFIG_USBD_HID_SUPPORT); the correct source file is selected
      automatically based on which stack is enabled. Requires ZMK.

config HID_PASSTHROUGH_USB_LEGACY
    def_bool y
    depends on HID_PASSTHROUGH_USB && USB_DEVICE_HID

config HID_PASSTHROUGH_USB_NEXT
    def_bool y
    depends on HID_PASSTHROUGH_USB && USBD_HID_SUPPORT

config HID_PASSTHROUGH_BLE
    bool "BLE HID Passthrough for touchpad"
    depends on ZMK_BLE
    default y
    help
      Enable BLE HOGP passthrough for the touchpad as a second HID service,
      notifying the central of ZMK's active profile. Requires ZMK.

config HID_PASSTHROUGH_BLE_WORKQUEUE_STACK_SIZE
    int "BLE passthrough notify work queue stack size"
    depends on HID_PASSTHROUGH_BLE
    default 1024
    help
      Stack size of the work queue that sends the touchpad's BLE
      notifications (bt_gatt_notify_cb: ATT encode + L2CAP path). The
      previous fixed 768 bytes never overflowed on hardware but had no
      headroom analysis behind it.

config HID_PASSTHROUGH_BLE_PACE_MS
    int "Fallback pace for BLE PTP motion notifications (ms, 0=off)"
    depends on HID_PASSTHROUGH_BLE
    default 10
    help
      Coalesce absolute-position (PTP) input reports so pure-motion
      notifications go out at most once per BLE connection event; frames
      whose tip/confidence/contact-id/button state changed are sent
      immediately. Keeps host arrival timestamps regular (libinput's
      touchpad jump detection discards motion of frames that arrive
      back-to-back within one connection event).

      The pace normally follows the connection interval the central
      granted, plus HID_PASSTHROUGH_BLE_PACE_MARGIN_US; this value is only
      used while no connection info is available. 0 disables pacing
      entirely (forward every frame).

config HID_PASSTHROUGH_BLE_PACE_MARGIN_US
    int "Margin added to the granted connection interval for the PTP pace (us)"
    depends on HID_PASSTHROUGH_BLE
    default 500
    help
      How far ABOVE the granted connection interval to pace PTP motion
      notifications. The pace must exceed the interval for coalescing to
      happen at all: a pad that reports faster than the event grid (the
      140 Hz firmware reports every 7.10 ms against 7.5 ms events) puts its
      surplus frames into one connection event as burst-mates, whose motion
      libinput's jump detection discards. Pacing above the interval spends
      those frames in the driver instead, where dropping them is free
      because PTP positions are absolute.

      The cost is one connection event in interval/margin carrying no new
      frame: a 15 ms arrival gap with normal single-frame travel, which is
      benign. At the 7.5 ms both our centrals grant, 500 us gives one such
      gap every 15 frames and 125 frames/s delivered; 250 us gives one
      every 30 and 129 frames/s.

      Too small and send-path scheduling jitter lands two sends in one
      event again, which is the artifact being fixed, so lower it only with
      an arrival histogram to show 0% of arrivals under 2 ms.

config HID_PASSTHROUGH_BLE_FEATURE_PAD_BYTE
    bool "Append one dummy byte to BLE feature GET responses (BlueZ workaround)"
    depends on HID_PASSTHROUGH_BLE
    default y
    help
      bluetoothd up to and including BlueZ 5.87 drops the last byte of
      every numbered HID GET_REPORT reply from a HoG device
      (src/shared/uhid.c bt_uhid_get_report_reply prepends the report ID
      but does not count it). A one-byte feature such as the PTP input
      mode or contact-count maximum then reads back as 0, and register
      access protocols that put the value in the last byte break.

      With this option the Report characteristic's read value is the
      pad's feature data plus one trailing 0x00, so the truncated host
      still receives the complete report. Fixed hosts are unaffected:
      Linux uhid/hidraw copy at most the caller's requested length, so
      the extra byte is discarded. Feature SETs are not changed.

config HID_TOUCHPAD_PIXART_UPDATE
    bool "PixArt PJP360 firmware update protocol"
    help
      Compile pixart_tp_update.c: the PixArt touchpad flash protocol
      (fwupd plugins/pixart-tp, ported) driven from the keyboard MCU over
      the pad's vendor feature reports 0x41-0x43. Gives a board the
      pixart_tp_read_info()/pixart_tp_update() API to carry the pad's
      firmware in its own image and converge the pad to it. Policy (when to
      flash, power gating, factory hooks) lives in the board, not here.

config HID_TOUCHPAD_INPUT_STATS
    bool "Log 1 Hz input-report rate and I2C read timing"
    help
      Diagnostic for touchpad frame-rate/latency investigations: once per
      second, log how many input reports were read and the average/maximum
      duration of the input-report I2C read. Splits "each read is slow" from
      "reads are infrequent" from "frames pile up on the way out". Costs a
      cycle-counter read around every I2C read and one INF log line per
      second while the pad reports, so leave it off in production builds.

module = HID_TOUCHPAD
module-str = hid_touchpad
source "subsys/logging/Kconfig.template.log_config"

module = HID_PASSTHROUGH_USB
module-str = hid_passthrough_usb
source "subsys/logging/Kconfig.template.log_config"

module = HID_PASSTHROUGH_BLE
module-str = hid_passthrough_ble
source "subsys/logging/Kconfig.template.log_config"

endif #HID_TOUCHPAD
```
